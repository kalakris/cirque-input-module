## dts/bindings/input/cirque,pinnacle-common.yaml
```yaml
properties:
  dr-gpios:
    type: phandle-array
    description: Data ready pin for the trackpad
  rotate-90:
    type: boolean
  x-invert:
    type: boolean
  y-invert:
    type: boolean
  sleep:
    type: boolean
  no-secondary-tap:
    type: boolean
  no-taps:
    type: boolean
  abs-mode:
    type: boolean
    description: |
      Run the Pinnacle in absolute mode. Instead of relative REL_X/REL_Y
      deltas, the driver reports INPUT_ABS_X (0-2047), INPUT_ABS_Y (0-1535)
      and INPUT_ABS_Z (touch strength, 0 on lift-off) per sample. Hardware
      tap gestures and the X/Y inversion / rotation feed transforms are not
      applied in this mode; consumers get raw pad coordinates.
  stream-tap-click:
    type: boolean
    description: |
      Enable firmware tap-to-click for consumers of the absolute stream
      (ZMK's CONFIG_ZMK_TOUCH_STREAM module). Only meaningful together
      with abs-mode, which disables the ASIC's own hardware tap
      gestures. A touch that lifts off within stream-tap-max-ms and
      moves at most stream-tap-max-movement raw counts is injected as a
      button-0 click into the normal input pipeline. The driver itself
      ignores this property.
  stream-tap-max-ms:
    type: int
    default: 180
    description: Maximum touch duration (ms) for a stream tap-to-click.
  stream-tap-max-movement:
    type: int
    default: 30
    description: |
      Maximum movement (raw counts, per-axis Chebyshev distance from the
      touch-down point) for a stream tap-to-click.
  sensitivity:
    type: string
    enum:
      - 1x
      - 2x
      - 3x
      - 4x
    description: ADC attenuation (sensitivity) setting.
  x-axis-z-min:
    type: int
    default: 5
  y-axis-z-min:
    type: int
    default: 4
```
